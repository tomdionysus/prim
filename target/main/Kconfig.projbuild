## target/main/Kconfig.projbuild
```kconfig
menu "prim test app"

    choice PRIM_BOARD
        prompt "Board"
        default PRIM_BOARD_HELTEC_V3
        help
            The board the suite runs on, set by the matching sdkconfig.<board>
            file. Only the name in the log depends on it: memory is found at
            run time (internal RAM is fast, PSRAM, where there is any, bulk).

        config PRIM_BOARD_HELTEC_V3
            bool "Heltec WiFi LoRa 32 V3"
        config PRIM_BOARD_HELTEC_V4
            bool "Heltec WiFi LoRa 32 V4"
        config PRIM_BOARD_TDECK
            bool "LilyGO T-Deck"
    endchoice

endmenu
```
